## components/ena-eke-proxy/Kconfig.projbuild
```kconfig
menu "ENA Exposue Key Export Proxy"
	
	config ENA_EKE_PROXY_KEYFILES_DAILY_URL
		string "Url to fetch daily keys"
		default "https://cwa-proxy.champonthis.de/version/v1/diagnosis-keys/country/DE/date/%s?page=%u&size=%u"
		help
			Defines the url to fetch keys. Datestring of ENA_EKE_PROXY_KEYFILES_DAILY_FORMAT (%s), page (%u) and size (%u) are passed as paramter. (Default https://cwa-proxy.champonthis.de/version/v1/diagnosis-keys/country/DE/date/%s?page=%u&size=%u)

	config ENA_EKE_PROXY_KEYFILES_HOURLY
		bool "Also fetch keys hourly"
		default true
		help
			If enabled, the hourly keys will be fetched for current day.

	config ENA_EKE_PROXY_KEYFILES_HOURLY_URL
		string "Url to fetch daily keys"
		depends on ENA_EKE_PROXY_KEYFILES_HOURLY
		default "https://cwa-proxy.champonthis.de/version/v1/diagnosis-keys/country/DE/date/%s/hour/%u?page=%u&size=%u"
		help
			Defines the url to fetch keys. Datestring of ENA_EKE_PROXY_KEYFILES_DAILY_FORMAT (%s), hour (%u), page (%u) and size (%u) are passed as paramter. (Default https://cwa-proxy.champonthis.de/version/v1/diagnosis-keys/country/DE/date/%s/hour/%u?page=%u&size=%u)

	config ENA_EKE_PROXY_KEYFILES_DAILY_FORMAT
		string "Format of date to fetch"
		default "%Y-%m-%d"
		help
			Defines the Datestring (%s) for setting the date in fetch url. (Default %Y-%m-%d)

	config ENA_EKE_PROXY_KEYFILES_UPLOAD_URL
		string "Url to upload keys"
		default "https://cwa-proxy.champonthis.de/version/v1/diagnosis-keys"
		help
			Defines the url to upload keys to. (Default https://cwa-proxy.champonthis.de/version/v1/diagnosis-keys)
		
	config ENA_EKE_PROXY_KEY_LIMIT
		int "Limit of keys to receive"
		default 500
		help
			Defines the limit of keys to receive in one request from server. (Default 500)

	config ENA_EKE_PROXY_MAX_PAST_DAYS
		int "Max. days to retrieve keys"
		default 14
		help
			Defines the maximum number of days to receive missed keys from server. (Default 14)

	config ENA_EKE_PROXY_AUTHORIZATION
		string "Authorization Header value (PanTra)"
		help
			Defines the value to put in Authorization header during key upload. (For PanTra key server)

endmenu
```

## components/ena/Kconfig
```kconfig
menu "Exposure Notification API"
  
  menu "Storage"   
  
    config ENA_STORAGE_DUMP
      bool "Dump storage"
      default false
      help
        Dump storage (stored TEKs, temp. beacons and perm. beacons) to serial output after scan.

    config ENA_STORAGE_TEK_MAX
      int "Max. TEKs"
      default 14
      help
        Defines the maximum number of TEKs to be stored. (Default 14 [14 * 144 => 14 days])

    config ENA_STORAGE_EXPOSURE_INFORMATION_MAX
      int "Max. exporure information"
      default 500
      help
        Defines the maximum number of exposure information to be stored. (Default 500)

    config ENA_STORAGE_TEMP_BEACONS_MAX
      int "Max. temporary beacons"
      default 1000
      help
        Defines the maximum number of temporary beacons to be stored. (Default 1000)

    config ENA_STORAGE_START_ADDRESS
      int "Storage start address"
      default 0
      help
        Defines the start address on partition. (Default 0)

    config ENA_STORAGE_PARTITION_NAME
      string "Partition name"
      default "ena"
      help
        Name of the partition used for storage. (Default "ena", see partitions.csv)

    config ENA_STORAGE_ERASE
      bool "Erase storage (!)"
      default false
      help
        Erases the complete(!) partition on startup and reset counters.

  endmenu
  
  menu "Scanning"
    config ENA_BEACON_TRESHOLD
      int "Contact threshold"
      default 300
      help
        Threshold in seconds after a received beacon is stored permanently. (Default 5 minutes)

    config ENA_SCANNING_TIME
      int "Scanning time"
      default 30
      help
        Time in seconds how long a scan should run. (Default 30 seconds)

    config ENA_SCANNING_INTERVAL
      int "Scanning interval"
      default 300
      help
        Interval in seconds for the next scan to happen. (Default 5 minutes)
  endmenu

  menu "Advertising"

    config ENA_BT_ROTATION_TIMEOUT_INTERVAL
      int "Rotation timeout interval"
      default 900
      help
        Base rotation timeout interval in seconds for changing BT address and therefore the advertised beacon. (Default 5 minutes)

    config ENA_BT_RANDOMIZE_ROTATION_TIMEOUT_INTERVAL
      int "Randomize rotation timeout interval"
      default 150
      help
        Range in seconds for randomize the rotation timeout interval. (Default +/- ~2.5 minutes)

    config ENA_TEK_ROLLING_PERIOD
      int "TEK rolling period"
      default 144
      help
        Defines the TEK rolling period in 10 minute steps. (Default 144 => 24 hours)
  endmenu

  menu "Miscellaneous"
    config ENA_RAM
      int "ENA RAM"
      default 100000
      help
        RAM required for main task. (Default 100 KB)
  endmenu

endmenu
```

## components/i2c-main/Kconfig.projbuild
```kconfig
menu "I²C"
	
	config I2C_SDA_PIN
		int "I²C sda pin"
		default 21

	config I2C_SCL_PIN
		int "I²C scl pin"
		default 22

	config I2C_CLOCKSPEED
		int "I²C clock speed"
		default 1000000

endmenu
```

## components/interface/Kconfig.projbuild
```kconfig
menu "ENA Interface"
	 
	config ENA_INTERFACE_IDLE_TIME
		int  "Seconds after display turns off on inactivity"
		default 15

	choice ENA_INTERFACE_DEVICE
		prompt "Choose device"
		default ENA_INTERFACE_CUSTOM
	
		config ENA_INTERFACE_CUSTOM
			bool "Custom"

				choice ENA_INTERFACE_CUSTOM_DISPLAY
					depends on 	ENA_INTERFACE_CUSTOM
					prompt "Choose custom display"
					default ENA_INTERFACE_DISPLAY_SSD1306
					config ENA_INTERFACE_DISPLAY_SSD1306
						bool "SSD1306"
					config ENA_INTERFACE_DISPLAY_NONE
						bool "none"
				endchoice 

				choice ENA_INTERFACE_CUSTOM_RTC
					depends on 	ENA_INTERFACE_CUSTOM
						prompt "Choose custom rtc"
						default ENA_INTERFACE_RTC_DS3231
						config ENA_INTERFACE_RTC_DS3231
							bool "DS3231"
						config ENA_INTERFACE_RTC_NONE
							bool "none"
				endchoice 

				choice ENA_INTERFACE_CUSTOM_INPUT
					depends on 	ENA_INTERFACE_CUSTOM
						prompt "Choose custom input"
						default ENA_INTERFACE_INPUT_CUSTOM
						config ENA_INTERFACE_INPUT_CUSTOM
							bool "7-Button input"
						config ENA_INTERFACE_INPUT_NONE
							bool "none"
				endchoice 

				menu "Custom I²C"
					depends on ENA_INTERFACE_CUSTOM

					config I2C_SDA_PIN
						int "I²C sda pin"
						default 21
				
					config I2C_SCL_PIN
						int "I²C scl pin"
						default 22

				endmenu

		config ENA_INTERFACE_M5STICKC
			bool "M5StickC"
	
		config ENA_INTERFACE_M5STICKC_PLUS
			bool "M5StickC PLUS"
	
		config ENA_INTERFACE_TTGO_T_WRISTBAND
			bool "TTGO T-Wristband"
	endchoice 

endmenu
```

## main/Kconfig.projbuild
```kconfig
menu "WiFi STA"

	config WIFI_STA_SSID
	string "Wifi SSID"

	config WIFI_STA_PASSWORD
	string "Wifi Password"

endmenu
```
